## trunk/proprietary/rt_wifi/rtpci/5.0.4.0/mt7615_ap/Kconfig
```kconfig
config DOT11_N_SUPPORT
	bool "802.11n support"
	default y

config DOT11_VHT_AC
	bool "802.11AC support"
	depends on DOT11_N_SUPPORT
	default y

config G_BAND_256QAM_SUPPORT
	bool "2.4G 256QAM support"
	depends on DOT11_VHT_AC
	default y

config TPC_SUPPORT
	bool "802.11h TPC Support"
	default y

config TXRX_STAT_SUPPORT
	bool "TxRx Stats Support"
	default n

config ICAP_SUPPORT
	bool "ICAP Support"
	depends on MT7615_AP
	default y

config SPECTRUM_SUPPORT
	bool "Wifi Spectrum Support"
	depends on MT7615_AP
	default y

config BACKGROUND_SCAN_SUPPORT
	bool "Background Scan Support"
	default y

config MT7615_AP_SMART_CARRIER_SENSE
	bool "Smart Carrier Sense Support"
	default y

config MT7615_AP_DFS
	bool "Dynamic Frequency Selection Support"
	default y

config OFFCHANNEL_SCAN_FEATURE
	bool "Channel Quality Monitor"
	depends on MT7615_AP
	default n

#config WFA_VHT_R2_PF
#    bool "WFA VHT R2 Plugfest"
#    depends on DOT11_VHT_AC
#    default n

config DBDC_MODE
	bool "dbdc mode support"
	select MULTI_PROFILE_SUPPORT
#	select DEFAULT_5G_PROFILE
	default y

config MULTI_PROFILE_SUPPORT
	bool "Multi Profile Support"
	depends on DBDC_MODE
	default y

config DEFAULT_5G_PROFILE
	bool "5G default profile for DBDC"
	depends on DBDC_MODE
	default n

config DOT11W_PMF_SUPPORT
	bool "PMF"
	depends on MT7615_AP
	default y

config MT7615_AP_TXBF
	bool "Tx Bean Forming Support"
	default y

config FAST_NAT_SUPPORT
	bool "Fast-NAT support"
	depends on RA_HW_NAT_WIFI
	default n

config WHNAT_SUPPORT
	tristate "Wifi Hardware NAT support"
	depends on WLAN_HOOK
	depends on FAST_NAT_SUPPORT
	default n

config MT7615_AP_LLTD
	bool "LLTD (Link Layer Topology Discovery Protocol)"
	depends on MT7615_AP
	default n

#config QOS_DLS_SUPPORT
#	bool "802.11e DLS ((Direct-Link Setup) Support"
#	depends on MT7615_AP
#	default n

#config WAPI_SUPPORT
#	bool "WAPI Support"
#	default n

config FTM_SUPPORT
	bool "FTM Support"
	select PASSPOINT_R2
	default n

config MBO_SUPPORT
	bool "MBO Support"
	select INTERWORKING
	select WNM_SUPPORT
	select DOT11K_RRM_SUPPORT
	select DOT11R_FT_SUPPORT
	select DOT11W_PMF_SUPPORT
	default n

#config CARRIER_DETECTION_SUPPORT
#	bool "Carrier Detect"
#	default n

#config BLOCK_NET_IF
#	bool "NETIF Block"
#	depends on MT7615_AP
#	default n
#	help
#	Support Net interface block while Tx-Sw queue full

#config RATE_ADAPTION
#	bool "New Rate Adaptation support"
#	default y

#config NEW_RATE_ADAPT_SUPPORT
#	bool "Intelligent Rate Adaption"
#	depends on RATE_ADAPTION
#	default y

#config AGS_SUPPORT
#	bool "Adaptive Group Switching"
#	depends on RATE_ADAPTION
#	depends on MT7615_AP
#	default n

#config RATE_ADAPT_AGBS_SUPPORT
#	bool "Adaptive AGBS Mode"
#	depends on RATE_ADAPTION
#	depends on MT7615_AP
#	default y

#config IDS_SUPPORT
#	bool "IDS (Intrusion Detection System) Support"
#	depends on MT7615_AP
#	default n

#config WIFI_WORK_QUEUE
#	bool "Work Queue"
#	default n

#config WIFI_SKB_RECYCLE
#	bool "SKB Recycle(Linux)"
#	depends on MT7615_AP
#	default n

config PRE_CAL_TRX_SET1_SUPPORT
	bool "Calibration To Flash/BinFile Support"
	default y

config RLM_CAL_CACHE_SUPPORT
	bool "RlmCalibrationCache Support"
	default y

config PRE_CAL_TRX_SET2_SUPPORT
	bool "Pre-calibration to Flash Support"
	default y

config CAL_BIN_FILE_SUPPORT
	bool "Calibration to BinFile Support"
	default y

config RF_LOCKDOWN_SUPPORT
	bool "RF Lockdown Support"
	default n

config LINK_TEST_SUPPORT
	bool "Link Test Support"
	default y

config WIFI_EAP_FEATURE
	bool "EAP Feature Support"
	default y

#config LED_CONTROL_SUPPORT
#	bool "LED Support"
#	depends on MT7615_AP
#	default n

config ATE_SUPPORT
	bool "ATE/QA Support"
	default y

config PASSPOINT_R2
	bool "Passpoint Release-2 Support"
	select DOT11W_PMF_SUPPORT
	depends on MT7615_AP
	default n

#config TRACE_TCP_PKT
#       bool "TCP DATA/ACK packets trace log"
#       default n

config TCP_RACK_SUPPORT
	bool "TCP Reduced ACK  support"
	default n

#### PA_LNA_Type choice

config RED_SUPPORT
	bool "RED(Random Early Drop) support"
	depends on MT7615_AP
	default y

config FDB_SUPPORT
       bool "FW Debug Port"
       default n

choice
        prompt "PA LNA Type of 1st Card"
		depends on ! RT_FIRST_IF_NONE
		
		config FIRST_IF_EPAELNA
		bool "ePAeLNA"
		config FIRST_IF_IPAILNA
		bool "iPAiLNA"		
		config FIRST_IF_IPAELNA
		bool "iPAeLNA"
#		config FIRST_IF_EPAILNA
#		bool "ePAiLNA"
endchoice
choice
        prompt "PA LNA Type of 2nd Card"
		depends on ! RT_SECOND_IF_NONE
		
		config SECOND_IF_EPAELNA
		bool "ePAeLNA"
		config SECOND_IF_IPAILNA
		bool "iPAiLNA"		
		config SECOND_IF_IPAELNA
		bool "iPAeLNA"
#		config SECOND_IF_EPAILNA
#		bool "ePAiLNA"
endchoice
#### PA_LNA_Type choice END 


#if CHIP_MT7615E
#	config MT_MAC
#		bool
#		default y
#		select RATE_ADAPTION
#		select RATE_ADAPT_AGBS_SUPPORT
#		select DOT11_N_SUPPORT
#		select DOT11_VHT_AC
#		select HDR_TRANS_TX_SUPPORT
#		select HDR_TRANS_RX_SUPPORT
#endif


config MT7615_AP
	tristate "MT7615 AP support"
#	depends on NET_RADIO
	select WIRELESS_EXT
	select WEXT_SPY
	select WEXT_PRIV

config MT7615_AP_WDS
	bool "WDS"
	depends on MT7615_AP
	default y

config WIFI_EAP_FEATURE
	bool "EAP Feature"
	default y

config MT7615_AP_MBSS
	bool "MBSSID"
	depends on MT7615_AP
	default y

#config NEW_MBSSID_MODE
#	bool "New MBSSID MODE"
#	depends on MT7615_AP && MT7615_AP_MBSS
#	depends on RALINK_RT3883 || RALINK_RT3352 || RALINK_RT5350 || RALINK_RT6352 || RALINK_MT7620
#	default y

#config ENHANCE_NEW_MBSSID_MODE
#	bool "Enhanced MBSSID mode"
#	depends on NEW_MBSSID_MODE
#	default y

config MT7615_AP_APCLI
	bool "AP-Client Support"
	depends on MT7615_AP
	default y

config MT7615_AP_MULTI_APCLI
	bool "Multi AP-Client support"
	depends on MT7615_AP
	depends on MT7615_AP_APCLI
	default n

config MT7615_AP_APCLI_CERT
	bool "AP-Client TGn Cert Support"
	depends on MT7615_AP
	depends on MT7615_AP_APCLI
	default n

config MT7615_AP_MAC_REPEATER
	bool "MAC Repeater Support"
	depends on MT7615_AP
	depends on MT7615_AP_APCLI
	default y

config MT7615_AP_MWDS
	bool "Mixed WDS(MWDS)"
	depends on MT7615_AP
	select MT7615_AP_APCLI
	default n

config MUMIMO_SUPPORT
	bool "MU-MIMO Support"
	select MU_RA_SUPPORT
	default y

config MU_RA_SUPPORT
	bool "MU-RGA Support"
	depends on MUMIMO_SUPPORT

config DOT11R_FT_SUPPORT
	bool "802.11r Fast BSS Transition"
	depends on MT7615_AP
	default n

config DOT11K_RRM_SUPPORT
	bool "802.11k Radio Resource Management"
	depends on MT7615_AP
	default n

config INTERWORKING
	bool "802.11u Interworking/Gas Support"
	depends on MT7615_AP
	default n

config MAP_SUPPORT
	bool "Multi-AP Support"
	depends on MT7615_AP
	select MBO_SUPPORT
	default n

config OFFCHANNEL_SCAN_FEATURE
	bool "Channel Quality Monitor"
	depends on MT7615_AP
	default n

config SNIFFER_SUPPORT
	bool "SNIFFER"
	depends on MT7615_AP
	default n

config ENTERPRISE_AP_SUPPORT
	bool "Enterprise AP Support"
	depends on MT7615_AP
	default n

config VLAN_SUPPORT
	bool "VLAN Support"
	depends on MT7615_AP
	depends on ENTERPRISE_AP_SUPPORT
	default n

config DYNAMIC_VLAN_SUPPORT
	bool "Dynamic VLAN Support"
	depends on MT7615_AP
	depends on ENTERPRISE_AP_SUPPORT
	default n

config CFG80211_SUPPORT
	bool "CFG80211"
	depends on MT7615_AP
	default n

#CUSTOMISED HOSTAPD
config CUSTOMISED_HOSTAPD_SUPPORT
	bool "Customised Hostapd Support"
	depends on MT7615_AP
	depends on CFG80211_SUPPORT
	default n

#APCLI STA
config APCLI_STA_SUPPORT
	bool "APCLI STA Support"
	depends on MT7615_AP_APCLI
	depends on CFG80211_SUPPORT
	default n

#WDS STA
config WDS_STA_SUPPORT
	bool "WDS STA Support"
	depends on MT7615_AP_APCLI
	depends on CFG80211_SUPPORT
	default n

#WDS AP
config MBSS_AS_WDS_AP_SUPPORT
	bool "MBSS AS WDS AP Support"
	depends on MT7615_AP
	depends on MT7615_AP_MBSS
	default n

config DSCP_QOS_MAP_SUPPORT
	bool "Dscp Qos Mapping Support"
	depends on MT7615_AP
	default n

config DSCP_PRI_SUPPORT
	bool "Dscp Priority Mapping Support"
	depends on MT7615_AP
	default n

#HOSTAPD_MAP_SUPPORT
config HOSTAPD_MAP_SUPPORT
	bool "MAP with Hostapd Support"
	depends on MT7615_AP
	depends on CFG80211_SUPPORT
	depends on MAP_SUPPORT
	default n

config MIN_PHY_RATE_SUPPORT
	bool "Minimum PHY rate support"
	depends on MT7615_AP
	default n

config FAST_UP_RATE_SUPPORT
	bool "Fast UP rate support"
	depends on MT7615_AP
	default n

config RADIUS_MAC_AUTH_SUPPORT
	bool "RADIUS MAC Auth Support"
	depends on ENTERPRISE_AP_SUPPORT
	depends on CFG80211_SUPPORT
	default n

config MT7615_AP_LLTD
	bool "LLTD (Link Layer Topology Discovery Protocol)"
	depends on MT7615_AP

#config COC_SUPPORT
#	bool "CoC Support"
#	depends on MT7615_AP
#	default n

#config EXT_BUILD_CHANNEL_LIST
#	bool "Extension Channel List"
#	depends on MT7615_AP

#config AUTO_CH_SELECT_ENHANCE
#	bool "Auto Channel Selection Enhancement"
#	depends on MT7615_AP

config VOW_SUPPORT
	bool "MediaAir(VOW) support"
	depends on MT7615_AP
	default y

#config AIRPLAY_SUPPORT
#	bool "AIRPLAY Support"
#	depends on MT7615_AP
#	default n

config LED_CONTROL_SUPPORT
	bool "LED Control Support"
	default n

config WLAN_HOOK
	bool "WLAN hook Support"
	default n

config RADIUS_ACCOUNTING_SUPPORT
	bool "Radius Accounting Support"
	depends on MT7615_AP
	default n

config GREENAP_SUPPORT
	bool "GreenAP Support"
	depends on MT7615_AP
	default y

config TXRX_STAT_SUPPORT
	bool "TxRx Stats Support"
	default n

config PCIE_ASPM_DYM_CTRL_SUPPORT
	bool "Pcie Aspm Dynamic Control Support"
	depends on MT7615_AP
	default y

config COEX_SUPPORT
	bool "Coex Support"
	depends on MT7615_AP
	default n

config EASY_SETUP_SUPPORT
	bool "Whole Home Coverage - Easy Setup"
	depends on MT7615_AP
	default n

config EVENT_NOTIFIER_SUPPORT
	bool "Whole Home Coverage - Event Notifier"
	depends on MT7615_AP
	default n

config AIR_MONITOR
	bool "Air Monitor"
	depends on MT7615_AP
	default n

config WNM_SUPPORT
	bool "802.11v WNM Support"
	depends on MT7615_AP
	default n

#config ROAMING_ENHANCE_SUPPORT
#	bool "Roaming Enhance Support"
#	depends on MT7615_AP
#	depends on MT7615_AP_APCLI
#	default n

#config WIFI_FWD_SUPPORT
#	bool "WiFi Forwarding Support"
#	default n

config WPA3_SUPPORT
	bool "WPA3 support"
	depends on MT7615_AP
	default y

config OWE_SUPPORT
	bool "Enhance OPEN(OWE) support"
	depends on MT7615_AP
	depends on WPA3_SUPPORT
	default y

config VENDOR_FEATURE10_SUPPORT
	bool "Vendor10 Feature Enable"
	depends on MT7615_AP
	default n

config VENDOR_FEATURE11_SUPPORT
	bool "Vendor11 Feature Enable"
	depends on MT7615_AP
	default n
```
